## Kconfig.projbuild
```kconfig
menu "Component drv_console Configuration"

    config DRV_CONSOLE_USE
        bool "Use drv_console component"
        default y
        help
            Use of component enabled by default
        
    config DRV_CONSOLE_CUSTOM
        bool "Use Custom Console"
        default n

    config DRV_CONSOLE_CUSTOM_LOG_DISABLE_FIX
        depends on DRV_CONSOLE_CUSTOM
        bool "Use Custom Console Log Disable"
        default n

    config DRV_CONSOLE_LOG_NON_BLOCKING
        bool "Use Non-blocking Log Print"
        default y

endmenu
```
